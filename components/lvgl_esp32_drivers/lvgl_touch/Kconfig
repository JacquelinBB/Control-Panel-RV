## components/lvgl_esp32_drivers/lvgl_touch/Kconfig
```kconfig
menu "LVGL Touch controller"

    config LV_TOUCH_CONTROLLER
	int
	default 0 if LV_TOUCH_CONTROLLER_NONE
	default 1 if LV_TOUCH_CONTROLLER_XPT2046
	default 2 if LV_TOUCH_CONTROLLER_FT6X06
	default 3 if LV_TOUCH_CONTROLLER_STMPE610
        default 4 if LV_TOUCH_CONTROLLER_ADCRAW
        default 5 if LV_TOUCH_CONTROLLER_FT81X
        default 6 if LV_TOUCH_CONTROLLER_RA8875

    choice
	prompt "Select a touch panel controller model."
	default LV_TOUCH_CONTROLLER_NONE
	help
	    Select the controller for your touch panel.

	config LV_TOUCH_CONTROLLER_NONE
	    bool "None"
	config LV_TOUCH_CONTROLLER_XPT2046
            select LV_TOUCH_DRIVER_PROTOCOL_SPI
            bool "XPT2046"
    endchoice
    
    config LV_TOUCH_DRIVER_PROTOCOL_SPI
        bool
        help
            Touch controller protocol SPI

    config LV_TOUCH_DRIVER_DISPLAY
        bool
        help
            Touch controller uses same interface/device as display
	    (Note: Display must be initialized before touch)
    
    choice
        prompt "Touch Controller SPI Bus."
        depends on LV_TOUCH_DRIVER_PROTOCOL_SPI
        
        default LV_TOUCH_CONTROLLER_SPI_VSPI if !IDF_TARGET_ESP32S2
        default LV_TOUCH_CONTROLLER_SPI_FSPI if IDF_TARGET_ESP32S2
        help
            Select the SPI Bus the TFT Display is attached to.
    
        config LV_TOUCH_CONTROLLER_SPI_HSPI
            bool "HSPI"
        config LV_TOUCH_CONTROLLER_SPI_VSPI
            bool "VSPI" if !IDF_TARGET_ESP32S2
        config LV_TOUCH_CONTROLLER_SPI_FSPI
            bool "FSPI" if IDF_TARGET_ESP32S2
        endchoice
    
    menu "Touchpanel (XPT2046) Pin Assignments"
        depends on LV_TOUCH_CONTROLLER_XPT2046

        config LV_TOUCH_SPI_MISO
            int
            prompt "GPIO for MISO (Master In Slave Out)"
            range 0 39 if IDF_TARGET_ESP32
            range 0 43 if IDF_TARGET_ESP32S2
            
            default 35 if LV_PREDEFINED_PINS_38V1
            default 19
            help
            Configure the touchpanel MISO pin here.

        config LV_TOUCH_SPI_MOSI
            int
            prompt "GPIO for MOSI (Master Out Slave In)"
            range 0 39 if IDF_TARGET_ESP32
            range 0 43 if IDF_TARGET_ESP32S2

            default 32 if LV_PREDEFINED_PINS_38V1
            default 23
            help
            Configure the touchpanel MOSI pin here.

        config LV_TOUCH_SPI_CLK
            int "GPIO for CLK (SCK / Serial Clock)"
            range 0 39 if IDF_TARGET_ESP32
            range 0 43 if IDF_TARGET_ESP32S2
            
            default 26 if LV_PREDEFINED_PINS_38V1
            default 18
            help
            Configure the touchpanel CLK pin here.

        config LV_TOUCH_SPI_CS
            int "GPIO for CS (Slave Select)"
            range 0 39 if IDF_TARGET_ESP32
            range 0 43 if IDF_TARGET_ESP32S2
            
            default 33 if LV_PREDEFINED_PINS_38V1
            default 5
            help
            Configure the touchpanel CS pin here.

        config LV_TOUCH_PIN_IRQ
            int "GPIO for IRQ (Interrupt Request)"
            range 0 39 if IDF_TARGET_ESP32
            range 0 43 if IDF_TARGET_ESP32S2
	    
            default 27 if LV_PREDEFINED_PINS_38V4
            default 25
            help
            Configure the touchpanel IRQ pin here.
    endmenu
    
    menu "Touchpanel Configuration (XPT2046)"
        depends on LV_TOUCH_CONTROLLER_XPT2046

        config LV_TOUCH_X_MIN
            int
            prompt "Minimum X coordinate value."
            default 0 if LV_PREDEFINED_PINS_38V4
            default 200

        config LV_TOUCH_Y_MIN
            int
            prompt "Minimum Y coordinate value."
            default 0 if LV_PREDEFINED_PINS_38V4
            default 120

        config LV_TOUCH_X_MAX
            int
            prompt "Maximum X coordinate value."
            default 4095 if LV_PREDEFINED_PINS_38V4
            default 1900

        config LV_TOUCH_Y_MAX
            int
            prompt "Maximum Y coordinate value."
            default 4095 if LV_PREDEFINED_PINS_38V4
            default 1900
        
		config LV_TOUCH_XY_SWAP
        	bool
        	prompt "Swap XY."
        	default y

        config LV_TOUCH_INVERT_X
            bool
            prompt "Invert X coordinate value."
            default y

        config LV_TOUCH_INVERT_Y
            bool
            prompt "Invert Y coordinate value."
            default y

        choice
            prompt "Select touch detection method."
            default LV_TOUCH_DETECT_IRQ
            help
                Select the controller for your touch panel.

            config LV_TOUCH_DETECT_IRQ
                bool "IRQ pin only"
            config LV_TOUCH_DETECT_IRQ_PRESSURE
                bool "IRQ pin and pressure"
            config LV_TOUCH_DETECT_PRESSURE
                bool "Pressure only"
        endchoice
    endmenu

endmenu
```
